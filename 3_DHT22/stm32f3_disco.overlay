/*
 * SPDX-License-Identifier: Apache-2.0
 * 
 * Device tree overlay for DHT22 sensor on STM32F3 Discovery
 * DHT22 connected to GPIO PA1 with internal pull-up enabled
 */

/ {
	/*
	 * DHT22 Temperature and Humidity Sensor
	 * Data line connected to PA1 with internal pull-up
	 * Sensor will be polled every 2 seconds from main.c
	 */
	dht22_sensor: dht22 {
		compatible = "aosong,dht";
		status = "okay";
		dio-gpios = <&gpioa 1 (GPIO_ACTIVE_HIGH | GPIO_PULL_UP)>;  /* PA1 for DHT22 data line with pull-up */
	};

	/*
	 * Aliases for easy access in code
	 * Allows DEVICE_DT_GET(DT_ALIAS(dht22)) to work
	 */
	aliases {
		dht22 = &dht22_sensor;
	};
};

/*
 * GPIO Port A Configuration
 * PA1 enabled for DHT22 sensor with internal pull-up
 */
&gpioa {
	status = "okay";
};

